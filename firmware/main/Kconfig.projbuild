## firmware/main/Kconfig.projbuild
```kconfig
menu "Example Configuration"

    orsource "$IDF_PATH/examples/common_components/env_caps/$IDF_TARGET/Kconfig.env_caps"



    menu "NMEA Statement Support"
        comment "At least one statement must be selected"
        config NMEA_STATEMENT_GGA
            bool "GGA Statement"
            default y
            help
                Enabling this option will parse the following parameter from GGA statement:

                - Latitude, Longitude, Altitude;
                - Number of satellites in use, fix status (no fix, GPS, DGPS), UTC time;

        config NMEA_STATEMENT_GSA
            bool "GSA Statement"
            default y
            help
                Enabling this option will parse the following parameter from GSA statement:

                - Position/Vertical/Horizontal dilution of precision;
                - Fix mode (no fix, 2D, 3D fix);
                - IDs of satellites in use;

        config NMEA_STATEMENT_GSV
            bool "GSV Statement"
            default y
            help
                Enabling this option will parse the following parameter from GSV statement:

                - Number of satellites in view;
                - Optional details of each satellite in view;

        config NMEA_STATEMENT_RMC
            bool "RMC Statement"
            default y
            help
                Enabling this option will parse the following parameter from RMC statement:

                - Validity of GPS signal;
                - Ground speed (knots) and course over ground (degrees);
                - Magnetic variation;
                - UTC date;

        config NMEA_STATEMENT_GLL
            bool "GLL Statement"
            default y
            help
                Enabling this option will parse the following parameter from GLL statement:

                - Latitude, Longitude;
                - UTC time;

        config NMEA_STATEMENT_VTG
            bool "VTG Statement"
            default y
            help
                Enabling this option will parse the following parameter from VTG statement:

                - Ground speed (knots, km/h) and course over ground (degrees);
                - Magnetic variation;

    endmenu

endmenu
```

## firmware/sdkconfig.defaults
```kconfig
CONFIG_ESPTOOLPY_FLASHSIZE_8MB=y
CONFIG_PARTITION_TABLE_CUSTOM=y
CONFIG_PARTITION_TABLE_CUSTOM_FILENAME="partitions.csv"

CONFIG_HTTPD_MAX_REQ_HDR_LEN=1024
CONFIG_SPIFFS_OBJ_NAME_LEN=64
CONFIG_FATFS_LFN_HEAP=y

# Application Rollback
CONFIG_BOOTLOADER_APP_ROLLBACK_ENABLE=y


CONFIG_IDF_TARGET="esp32s3"
CONFIG_FREERTOS_HZ=1000
CONFIG_ESPTOOLPY_FLASH_MODE_AUTO_DETECT=n

CONFIG_ESP_TASK_WDT_TIMEOUT_S=10
```
